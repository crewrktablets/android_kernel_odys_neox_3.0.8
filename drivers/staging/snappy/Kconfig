## drivers/staging/snappy/Kconfig
```kconfig
config SNAPPY_COMPRESS
	bool "Snappy compression support"
	depends on ZRAM
	default n

config SNAPPY_DECOMPRESS
	bool "Sanppy decompresion support"
	depends on ZRAM
	default n
```
